## boards/atmel/sam0/same51_cnano/Kconfig.same51_cnano
```kconfig
# Copyright (c) 2019 Benjamin Valentin
# Copyright (c) 2024 Gerson Fernando Budke <nandojve@gmail.com>
# SPDX-License-Identifier: Apache-2.0

config BOARD_SAME51_CNANO
	select SOC_SAME51J20A
```
